## drivers/oneplus/Kconfig
```kconfig
source "drivers/oneplus/coretech/Kconfig"
source "drivers/oneplus/fs/Kconfig"
source "drivers/oneplus/opslalib/Kconfig"
```

## drivers/oneplus/coretech/Kconfig
```kconfig
config OPCHAIN
	default n
	bool "Oneplus CoreTech helper, used for opchain module"

config DEFRAG_HELPER
	default n
	bool "Oneplus CoreTech helper, used for defrag module"

config CRPL_HELPER
	default n
	bool "Oneplus CoreTech helper, used for crpl module"

config ADJ_CHAIN
	default n
	bool "Chain task adj for victim select"
	help
	 To chain task adj for any purpose

config FSC
	default n
	bool "system layer file status cache"
	help
	 To cache absence file and avoid stat call storm
config HOUSTON
	default n
	bool "to collect system-wide and pmu data"
	help
	 Realtime temperature monitor
config CONTROL_CENTER
	default n
	bool "control center"
	help
	 A framework to adjust system resource such as perfd, but easy to extend
	 the scope of use. Support priority control between different request and
	 QoS for keep adjusting for a specific period. Besides resource controlling,
	 it also provide a decision model for helping governor to make decision.

config AIGOV
	default n
	bool "A governor which using ai predicted info as input"

config IM
	bool "identify task itself"
	default n
	help
	  In many cases we need to identify task, all we do is simply string compare,
	  but in some performance sensitive context like scheduler, it's not a good choice to
	  do that. So this IM thing can let we check task only through one comparsion.

config MEMPLUS
	default n
	bool "memory+ feature"
	help
	 Memory+ feature

config SMART_BOOST
        bool "support smart boost feature"
        default n
        help
         Smart Boost feature
config TPD
	default n
	bool "a task placement decision for cpu limitation"
	help
	 Task affinity by decison
config CPUFREQ_BOUNCING
	default n
	bool "A power optimization feature to control excessive heating of devices"
config OPLUS_FEATURE_SUGOV_TL
	default n
	bool "A power optimization feature target loads"
```
